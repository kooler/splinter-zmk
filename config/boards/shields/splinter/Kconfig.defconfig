## config/boards/shields/splinter/Kconfig.defconfig
```kconfig
# Copyright (c) 2024 The ZMK Contributors
# SPDX-License-Identifier: MIT

if SHIELD_SPLINTER_LEFT

config ZMK_KEYBOARD_NAME
    default "Splinter"

config ZMK_SPLIT_ROLE_CENTRAL
    default y

endif

if SHIELD_SPLINTER_LEFT || SHIELD_SPLINTER_RIGHT

config ZMK_SPLIT
    default y

endif
```

## config/boards/shields/splinter/Kconfig.shield
```kconfig
# Copyright (c) 2024 The ZMK Contributors
# SPDX-License-Identifier: MIT

config SHIELD_SPLINTER_LEFT
    def_bool $(shields_list_contains,splinter_left)

config SHIELD_SPLINTER_RIGHT
    def_bool $(shields_list_contains,splinter_right)
```
